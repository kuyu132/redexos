/dts-v1/;
/plugin/;

/ {
    compatible = "raspberrypi,4-model-b";

    fragment@0 {
        target-path = "/chosen";
        __overlay__ {
            stdout-path = "serial0:115200n8";
        };
    };
};
